## main/Kconfig.projbuild
```kconfig
menu "Configuration wifi"
config WIFI_SSID
    string "WiFi SSID"
    default "your_wifi_ssid"
    help
      Enter the SSID of your WiFi network.

config WIFI_PASSWORD
    string "WiFi Password"
    default "your_wifi_password"
    help
      Enter the password for your WiFi network.
endmenu

menu "Configuration GPIO"
config DHT22_GPIO
    int "GPIO for DHT22"
    default 27
    help
      Enter the GPIO number for DHT22 sensor.

endmenu

menu "Configuration MQTT"

  config BROKER_CERTIFICATE_OVERRIDE
    string "Broker certificate override"
    default ""
    help
        Please leave empty if broker certificate included from a textfile; otherwise fill in a base64 part of PEM
        format certificate

  config MQTT_USERNAME
    string "MQTT username"
    default ""
    help
      Enter the username for your MQTT broker.

  config MQTT_PASSWORD
    string "MQTT password"
    default ""
    help
      Enter the password for your MQTT broker.
endmenu
```
